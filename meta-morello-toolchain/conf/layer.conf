## meta-morello-toolchain/conf/layer.conf
```bitbake
BBPATH .= ":${LAYERDIR}"

BBFILES += "${LAYERDIR}/recipes-*/*/*.bb \
	        ${LAYERDIR}/recipes-*/*/*.bbappend"

BBFILE_COLLECTIONS                     += "meta-morello-toolchain"
BBFILE_PATTERN_meta-morello-toolchain  := "^${LAYERDIR}/"
BBFILE_PRIORITY_meta-morello-toolchain  = "5"

LAYERDEPENDS_meta-morello-toolchain = " \
    core \
"
LAYERSERIES_COMPAT_meta-morello-toolchain = "kirkstone"

PURECAP_SYSROOT_DIR ??= "/usr/lib/${GLOBAL_ARCH_TRIPLE}"

C64_ARCH_TRIPLE ??= "aarch64-linux-musl_purecap"
A64_ARCH_TRIPLE ??= "aarch64-linux-gnu"

A64_LIB_TRIPLE ??= "aarch64-unknown-linux-gnu"
C64_LIB_TRIPLE ??= "aarch64-unknown-linux-musl_purecap"

A64_ARCH_FLAGS ??= "-march=armv8"
C64_ARCH_FLAGS ??= "-march=morello -mabi=purecap"

GLOBAL_ARCH_TRIPLE ??= "${C64_ARCH_TRIPLE}"
GLOBAL_LIB_TRIPLE  ??= "${C64_LIB_TRIPLE}"
GLOBAL_ARCH_FLAGS  ??= "${C64_ARCH_FLAGS}"

MORELLO_ARCH       ??= "c64"
TOOLCHAIN          ??= "gnu"
MORELLO_TOOLCHAIN  ??= "gcc-morello"

LLVM_SHARED_SOURCE ??= "${TMPDIR}/work-shared/${MACHINE}/llvm-morello-source"

require conf/compiler/gcc-morello.conf
require conf/compiler/llvm-morello.conf
```

## meta-morello/conf/layer.conf
```bitbake
BBPATH .= ":${LAYERDIR}"

BBFILES += "${LAYERDIR}/recipes-*/*/*.bb \
	        ${LAYERDIR}/recipes-*/*/*.bbappend"

BBFILE_COLLECTIONS          += "meta-morello"
BBFILE_PATTERN_meta-morello := "^${LAYERDIR}/"
BBFILE_PRIORITY_meta-morello = "5"

LAYERDEPENDS_meta-morello = " \
    core \
    meta-arm \
    meta-morello-toolchain \
"
LAYERSERIES_COMPAT_meta-morello = "kirkstone"
```

## meta-morello/conf/machine/include/morello-common.inc
```bitbake
require ${COREBASE}/meta/conf/machine/include/arm/armv8-2a/tune-neoversen1.inc

MACHINEOVERRIDES =. "morello"

PREFERRED_VERSION_board-firmware     = "morello-1.8"
PREFERRED_VERSION_edk2-firmware      = "morello-2.7"
PREFERRED_VERSION_scp-firmware       = "morello-2.1%"
PREFERRED_VERSION_fiptool-native     = "2.7"

PREFERRED_VERSION_trusted-firmware-a = "morello-2.9"

PREFERRED_PROVIDER_virtual/kernel = "linux-morello"
PREFERRED_VERSION_virtual/kernel  = "morello-master"

PREFERRED_VERSION_musl            = "morello-1.9"

GDBVERSION                        = "morello-11.0"

MORELLO_TOOLCHAIN ??= "llvm-morello"

APP_DIR ?= "pure-cap-apps"

KERNEL_IMAGETYPE       = "Image"

# Having an image name suffix breaks the fvpconf handling
IMAGE_NAME_SUFFIX       = ""
IMAGE_FSTYPES          += "wic"

WKS_FILE               ?= "morello-efidisk.wks"
WKS_FILE_DEPENDS:append = " ${EXTRA_IMAGEDEPENDS}"

EXTRA_IMAGEDEPENDS     += "virtual/scp-firmware"
EXTRA_IMAGEDEPENDS     += "virtual/trusted-firmware-a"
EXTRA_IMAGEDEPENDS     += "virtual/edk2-firmware"
EXTRA_IMAGEDEPENDS     += "board-firmware-image"

EFI_PROVIDER           ?= "grub-efi"
MACHINE_FEATURES       += "efi"

INITRAMFS_MAXSIZE      = "640000"
INITRAMFS_IMAGE        = "morello-initramfs-image"
INITRAMFS_IMAGE_BUNDLE = "0"
```

## meta-morello/conf/machine/morello-fvp.conf
```bitbake
require conf/machine/include/morello-common.inc

IMAGE_EFI_BOOT_FILES ?= "morello-fvp.dtb"

MACHINEOVERRIDES =. "morello-fvp:"

TCLIBCAPPEND = ""

BSP_GRUB_DIR ?= "${TMPDIR}/deploy/images/morello-fvp/grub-efi"
BSP_DTB_DIR  ?= "${TMPDIR}/deploy/images/morello-fvp"

TMPDIR = "${TOPDIR}/tmp-fvp"

MORELLO_TOOLCHAIN = "llvm-morello"

IMAGE_BASENAME       = "usb-image"

# The rootfs image that will go on a bootable drive
MORELLO_ROOTFS_IMAGE = "core-image-minimal"

IMAGE_INSTALL:append = " linux-firmware-rtl8168"
IMAGE_INSTALL:append = " musl-libc busybox-morello pure-cap-app llvm-morello gdbserver gdb llvm-morello-staticdev"

DISTRO ?= "poky"

SERIAL_CONSOLES = "115200;ttyAMA0"

# FVP Config
FVP_PROVIDER ?= "fvp-morello-native"
FVP_EXE      ?= "FVP_Morello"

# FVP Parameters
FVP_DATA += "Morello_Top.css.scp.armcortexm7ct=${DEPLOY_DIR_IMAGE}/rom-binaries/scp_romfw.bin@0x0"
FVP_DATA += "Morello_Top.css.mcp.armcortexm7ct=${DEPLOY_DIR_IMAGE}/rom-binaries/mcp_romfw.bin@0x0"

FVP_CONFIG[css.trustedBootROMloader.fname]          ?= "${DEPLOY_DIR_IMAGE}/rom-binaries/bl1.bin"

FVP_CONFIG[Morello_Top.soc.scp_qspi_loader.fname]   ?= "${DEPLOY_DIR_IMAGE}/scp_fw.bin"
FVP_CONFIG[Morello_Top.soc.mcp_qspi_loader.fname]   ?= "${DEPLOY_DIR_IMAGE}/mcp_fw.bin"

FVP_CONFIG[board.ap_qspi_loader.fname]              ?= "${DEPLOY_DIR_IMAGE}/fip.bin"

FVP_CONFIG[board.virtioblockdevice.image_path]      ?= "${DEPLOY_DIR_IMAGE}/usb-image-morello-fvp.wic"

FVP_CONFIG[board.virtio_net.hostbridge.userNetworking] ?= "1"
FVP_CONFIG[board.virtio_net.enabled]                   ?= "1"
FVP_CONFIG[board.virtio_net.transport]                 ?= "legacy"
FVP_CONFIG[board.virtio_net.hostbridge.userNetPorts]   ?= "8022=22"

FVP_CONFIG[css.scp.armcortexm7ct.INITVTOR]             ?= "0x0"
FVP_CONFIG[css.mcp.armcortexm7ct.INITVTOR]             ?= "0x0"

FVP_CONFIG[css.pl011_uart_ap.unbuffered_output]        ?= "1"
FVP_CONFIG[board.virtio_rng.enabled]                   ?= "1"
FVP_CONFIG[board.virtio_rng.seed]                      ?= "0"
FVP_CONFIG[num_clusters]                               ?= "2"
FVP_CONFIG[num_cores]                                  ?= "2"

FVP_CONFIG[disable_visualisation]                      ?= "true"
FVP_CONFIG[board.terminal_uart0_board.start_telnet]    ?= "0"
FVP_CONFIG[board.terminal_uart1_board.start_telnet]    ?= "0"
FVP_CONFIG[css.mcp.terminal_uart0.start_telnet]        ?= "0"
FVP_CONFIG[css.mcp.terminal_uart1.start_telnet]        ?= "0"
FVP_CONFIG[css.scp.terminal_uart_aon.start_telnet]     ?= "0"
FVP_CONFIG[css.terminal_sec_uart_ap.start_telnet]      ?= "0"
FVP_CONFIG[css.terminal_uart1_ap.start_telnet]         ?= "0"
FVP_CONFIG[css.terminal_uart_ap.start_telnet]          ?= "0"

FVP_TERMINALs[terminal_uart_ap]                        ?= "AP"
```

## meta-morello/conf/machine/morello-soc.conf
```bitbake
require conf/machine/include/morello-common.inc

MACHINEOVERRIDES =. "morello-soc:"

PREFERRED_VERSION_scp-firmware       = "2.10%"
PREFERRED_VERSION_trusted-firmware-a = "2.7%"
PREFERRED_VERSION_board-firmware     = "1.4"

TCLIBCAPPEND = ""

BSP_GRUB_DIR ?= "${TMPDIR}/deploy/images/morello-soc/grub-efi"
BSP_DTB_DIR  ?= "${TMPDIR}/deploy/images/morello-soc"

TMPDIR = "${TOPDIR}/tmp-soc"

MUSL_INSTALL_DIR ?= "${libdir}/${GLOBAL_ARCH_TRIPLE}"

IMAGE_BASENAME       = "rootfs"
IMAGE_FSTYPES:append = " ext4"

# The rootfs image that will go on a bootable drive
MORELLO_ROOTFS_IMAGE = "core-image-minimal"

IMAGE_INSTALL:append = " linux-firmware-rtl8168"

IMAGE_INSTALL:append = " musl-libc busybox-morello pure-cap-app llvm-morello gdbserver gdb llvm-morello-staticdev"

DISTRO ?= "poky"

SERIAL_CONSOLES = "115200;ttyAMA0"
```
